## conf/layer.conf
```bitbake
# We have a conf and classes directory, append to BBPATH
BBPATH .= ":${LAYERDIR}"

# We have a recipes directory, add to BBFILES
BBFILES += "${LAYERDIR}/recipes*/*/*.bb ${LAYERDIR}/recipes*/*/*.bbappend"

BBFILE_COLLECTIONS += "cpan-layer"
BBFILE_PATTERN_cpan-layer := "^${LAYERDIR}/"
BBFILE_PRIORITY_cpan-layer = "10"

# This should only be incremented on significant changes that will
# cause compatibility issues with other layers
LAYERVERSION_cpan-layer = "1"

LAYERDEPENDS_cpan-layer = "core openembedded-layer"
LAYERSERIES_COMPAT_cpan-layer = "honister"
```
